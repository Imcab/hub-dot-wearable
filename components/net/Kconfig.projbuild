## components/net/Kconfig.projbuild
```kconfig
menu "hub-dot WiFi"

    config HUBDOT_WIFI_SSID
        string "WiFi SSID"
        default ""
        help
            Nombre de la red. Dejalo vacio para no usar WiFi (los sensores siguen funcionando).
            El ESP32-C3 solo soporta redes de 2.4 GHz.

    config HUBDOT_WIFI_ENTERPRISE
        bool "WPA2-Enterprise (usuario + contraseña, por ejemplo eduroam)"
        default n
        help
            Apagado: WPA2-Personal, una contraseña compartida.
            Encendido: WPA2-Enterprise PEAP/MSCHAPv2 con tu propio usuario y contraseña.

    config HUBDOT_WIFI_PASSWORD
        string "Contraseña del WiFi"
        depends on !HUBDOT_WIFI_ENTERPRISE
        default ""
        help
            Dejalo vacio para una red abierta.

    config HUBDOT_WIFI_EAP_USERNAME
        string "Usuario Enterprise"
        depends on HUBDOT_WIFI_ENTERPRISE
        default ""

    config HUBDOT_WIFI_EAP_PASSWORD
        string "Contraseña Enterprise"
        depends on HUBDOT_WIFI_ENTERPRISE
        default ""

    config HUBDOT_DB_URL
        string "URL de la carpeta con los scripts PHP"
        default "http://10.48.69.181/proyecto"
        help
            Sin diagonal al final. Usa la IP de tu laptop (ipconfig en Windows); la placa y la
            laptop deben estar en la misma red. Dejalo vacio para no subir nada.

    config HUBDOT_TEAM_ID
        string "Equipo (para el tópico MQTT y el device_id)"
        default "eq01"
        help
            Publica en reto2026/<equipo>/data con device_id "<equipo>-hub" o "<equipo>-dot".

    config HUBDOT_MQTT_BROKER_URI
        string "URI del broker MQTT"
        default ""
        help
            Por ejemplo mqtt://192.168.1.10:1883. Dejalo vacio para no usar MQTT.

    config HUBDOT_MQTT_USERNAME
        string "Usuario del broker MQTT"
        default ""

    config HUBDOT_MQTT_PASSWORD
        string "Contraseña del broker MQTT"
        default ""

endmenu
```
